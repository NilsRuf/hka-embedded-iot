## CMakeLists.txt
```
# This file is used by the build system to find sources you want to compile.

# Some basic setup stuff. We won't go into great detail.
cmake_minimum_required(VERSION 3.20.0)
find_package(Zephyr REQUIRED HINTS $ENV{ZEPHYR_BASE})
project(NONE)

target_sources(app PRIVATE
    src/main.c
    # src/ble.c
    src/comm.c
)

# Enable more warnings
target_compile_options(app PRIVATE -Wall -Wextra)
```

## Kconfig
```
# Kconfig files are for defining custom configuration options.
# A config option MY_FOO is available in code as a preprocessor define called CONFIG_MY_FOO.

menu "Zephyr Kernel"
source "Kconfig.zephyr"
endmenu

config COMM_THREAD_STACK_SIZE
    int "Size of the comm thread stack"
    default 2048

config COMM_THREAD_PRIO
    int "Priority of the comm thread."
    default 10
```

## prj.conf
```kconfig
# This file enables submodules and configures all kinds of settings.

# Disable MCUBoot
CONFIG_BOOTLOADER_MCUBOOT=n

# Enable logging via the RTT subsystem
CONFIG_LOG=y
# Set this to y to get immediate logging instead of deferred logging. Might be useful for debugging.
CONFIG_LOG_MODE_IMMEDIATE=n
CONFIG_LOG_BACKEND_RTT=y
CONFIG_USE_SEGGER_RTT=y

# We need some more stack space for that.
CONFIG_SYSTEM_WORKQUEUE_STACK_SIZE=2048

# Here, we enable BLE and all the things it requires.
# For example, we need to persist some key material in the flash.
CONFIG_BT=y
CONFIG_BT_HCI=y
# Feel free to change the name.
CONFIG_BT_DEVICE_NAME="HKA-IoT"
CONFIG_BT_PERIPHERAL=y
CONFIG_BT_GATT_SERVICE_CHANGED=y
CONFIG_BT_DEVICE_APPEARANCE=0
CONFIG_BT_SETTINGS=y

# Flash settings for BLE
CONFIG_FLASH=y
CONFIG_FLASH_MAP=y
CONFIG_NVS=y
CONFIG_SETTINGS=y

# TODO: Uncomment this when doing the bonus exercise.
# Enabling the accelerometer
# CONFIG_ADXL362=y
# CONFIG_ADXL362_ACCEL_RANGE_8G=y
# CONFIG_ADXL362_ACCEL_ODR_25=y
# CONFIG_ADXL362_INTERRUPT_MODE=1
# CONFIG_ADXL362_TRIGGER_GLOBAL_THREAD=y
# CONFIG_ADXL362_ABS_REF_MODE=1
```

## thingy91_nrf52840.overlay
```dts
// In an overlay file you can define alternate configurations for your applications.
// You can, for example, enable or disable specific peripherals or remap them to different pins.

/ {
    chosen {
        zephyr,bt-uart = &uart1;
    };
};
```

## src/main.c
```c
// This file conains our application's entry point.

#include <zephyr/kernel.h>
#include <zephyr/logging/log.h>

// We register a log module here so we can use LOG_INF, LOG_ERR, etc. in this
// module.
LOG_MODULE_REGISTER(app);


int main(void)
{
    

    return 0;
}
```

## src/ble.c
```c
// This file implements the BLE part of the application.

// Read through the code and the comments to find out how to complete the sample.

#include <zephyr/kernel.h>
#include <zephyr/bluetooth/bluetooth.h>
#include <zephyr/bluetooth/conn.h>
#include <zephyr/bluetooth/hci.h>
#include <zephyr/bluetooth/gatt.h>
#include <zephyr/init.h>
#include <zephyr/logging/log.h>

#include "channels.h"

LOG_MODULE_REGISTER(ble);

// Current sensor measurement.
static struct sensor_msmt_message current_measurement = {0};

// TODO: Implement those four functions.
// Read callback functions for our characteristics.
// @param conn   The connection that is requesting to read
// @param attr   The attribute that's being read
// @param buf    Buffer to place the read result in
// @param len    Length of data to read
// @param offset Offset to start reading from
// Returns the number of bytes read or a BT error code.
static ssize_t read_temperature_bt(struct bt_conn *conn,
                            const struct bt_gatt_attr *attr,
					        void *buf, uint16_t len,
					        uint16_t offset);
static ssize_t read_pressure_bt(struct bt_conn *conn,
                         const struct bt_gatt_attr *attr,
					     void *buf, uint16_t len,
					     uint16_t offset);
static ssize_t read_humidity_bt(struct bt_conn *conn,
                        const struct bt_gatt_attr *attr,
					    void *buf, uint16_t len,
					    uint16_t offset);
static ssize_t read_gas_res_bt(struct bt_conn *conn,
                        const struct bt_gatt_attr *attr,
					    void *buf, uint16_t len,
					    uint16_t offset);

// Callback which is executed when a connection attempt has been handled.
// The err parameter indicates the success status of the connection attempt.
// TODO: Implement.
static void on_connected(struct bt_conn *conn, uint8_t err);

// Callback executed on device disconnect.
// The reason parameter indicates the reason for the disconnect.
// TODO: Implement. Make sure to start advertising again because it is disabled once a connection
// has been previously established.
static void on_disconnected(struct bt_conn *conn, uint8_t reason);

// We need to define a custom 128 bit UUID for the gas resistance characteristic because
// that does not exist.
static const struct bt_uuid_128 gas_resistance_uuid = BT_UUID_INIT_128(
    BT_UUID_128_ENCODE(0x00000001, 0x0000, 0x1000, 0x8000, 0x00805F9B34FB));

// Define the GATT service.
// The GATT service is based on the Environmental Sensing Service defined by the Bluetooth SIG.
// However, we need a custom service for gas resistance here as well.
BT_GATT_SERVICE_DEFINE(ess_svc,
    // This is the primary service we support
    BT_GATT_PRIMARY_SERVICE(BT_UUID_ESS),

    // Definition of a characteristic.
    // Each characteristic we need has a unique UUIDs. Except for the gas resistance, all UUIDs
    // are defined by BLE and accessible through BT_UUID_XXX macros
    // The first argument is the UUID, followed by access properties for the characteristic.
    // We always wand read and notify permissions so we can send updates to the connected device when
    // a value changes.
    // Next, we set the access permissions to read-only using BT_GATT_PERM_READ.
    // After that there is space for two function pointers. The first defines a read handler which is called
    // when a connected device wants to read out sensor measurement. The second one is for writing, so we
    // do not need that.
    // The last parameter is a pointer to our current measurement which is provided to the read handler.
    BT_GATT_CHARACTERISTIC(BT_UUID_TEMPERATURE,
                           BT_GATT_CHRC_READ | BT_GATT_CHRC_NOTIFY,
                           BT_GATT_PERM_READ, read_temperature_bt, NULL, &current_measurement),
    // This is optional and defines a humanly readable name for the characteristic along with its access permissions.
    BT_GATT_CUD("Temperature", BT_GATT_PERM_READ),

    // Here, we define the gas resistance characteristic using the custom 128-bit UUID.
    BT_GATT_CHARACTERISTIC(&gas_resistance_uuid.uuid,
                           BT_GATT_CHRC_READ | BT_GATT_CHRC_NOTIFY,
                           BT_GATT_PERM_READ, read_gas_res_bt, NULL, &current_measurement),
    BT_GATT_CUD("Gas Resistance", BT_GATT_PERM_READ),

    // TODO: Add the missing entries for pressure and humidity.
);

// Here are our read handlers.

static ssize_t read_temperature_bt(struct bt_conn *conn,
                            const struct bt_gatt_attr *attr,
					        void *buf, uint16_t len,
					        uint16_t offset)
{
    // Call bt_gatt_attr_read with the proper parameters here.
    // You can access the measurement value either globally or by using
    // attr->user_data.
    return 0; // Change return code to what bt_gatt_attr_read gives you.
}

// TODO: Implement those three functions.
static ssize_t read_pressure_bt(struct bt_conn *conn,
                         const struct bt_gatt_attr *attr,
					     void *buf, uint16_t len,
					     uint16_t offset)
{
    return 0; // Change return code to what bt_gatt_attr_read gives you.
}

static ssize_t read_humidity_bt(struct bt_conn *conn,
                        const struct bt_gatt_attr *attr,
					    void *buf, uint16_t len,
					    uint16_t offset)
{
    return 0; // Change return code to what bt_gatt_attr_read gives you.
}

static ssize_t read_gas_res_bt(struct bt_conn *conn,
                        const struct bt_gatt_attr *attr,
					    void *buf, uint16_t len,
					    uint16_t offset)
{
    return 0; // Change return code to what bt_gatt_attr_read gives you.
}

// Setting up advertising.
// This array defines the advertising data.
static const struct bt_data advertising_data[] = {
    // We do not advertise enhanced data rate.
    BT_DATA_BYTES(BT_DATA_FLAGS, BT_LE_AD_NO_BREDR),
    // This entry actually advertises our service.
    BT_DATA_BYTES(BT_DATA_UUID16_ALL, BT_UUID_ESS_VAL),

    // TODO: Add the device name using data bytes of type BT_DATA_NAME_COMPLETE.
    // The device name can be found in prj.conf.
    // Make sure to also provide the length of the name string as a third parameter.
};

// This function enables advertising.
static int start_advertising(void)
{
    // TODO: Start the advertising procedure using bt_le_adv_start.
    // Hint: We want to be connectable, so we need to specify BT_LE_ADV_CONN as the first parameter.
}

// Connection handling

// Callback which is executed when a connection attempt has been handled.
// TODO: Implement.
static void on_connected(struct bt_conn *conn, uint8_t err)
{

}

// Callback executed on device disconnect.
// TODO: Implement. Make sure to start advertising again because it is disabled once a connection
// has been previously established.
static void on_disconnected(struct bt_conn *conn, uint8_t reason)
{

}

// Callback structure which defines connection handlers.
static struct bt_conn_cb conn_callbacks = {
    .connected = on_connected,
    .disconnected = on_disconnected,
};

// Initializes the BLE module at boot.
static int ble_init(void)
{
    // First, we enable bluetooth.
    int err = bt_enable(NULL);
    if (err != 0) {
        LOG_ERR("failed to enable bluetooth: %d", err);
        return err;
    }

    // TODO: Register our connection handlers using bt_conn_cb_register.

    // TODO: Start advertising.

    return 0;
}

SYS_INIT(ble_init, APPLICATION, 99);
```

## src/channels.h
```c
// This header contains channel and structure definitions used by all the modules accessing zbus.

#ifndef _CHANNEL_H_
#define _CHANNEL_H_

#include <zephyr/kernel.h>
#include <zephyr/zbus/zbus.h>
#include <zephyr/drivers/sensor.h>

// Message containing new measurement values.
// Should be distributed via sensor_channel.
struct sensor_msmt_message {
    // TODO: Fill in your struct
    int dummy;
};

// Declares a global sensor channel.
// This does not define the channel! Definition needs to happen in one of the modules.
ZBUS_CHAN_DECLARE(sensor_channel);

#endif
```

## src/comm.c
```c
// This file implements the communication interface to the NRF52.

#include <zephyr/kernel.h>
#include <zephyr/device.h>
#include <zephyr/drivers/uart.h>
#include <zephyr/logging/log.h>

#include "channels.h"

// TODO: Implement your communication endpoint here.

LOG_MODULE_REGISTER(comm);

// Handle to the UART device.
const struct device *uart = DEVICE_DT_GET(DT_NODELABEL(uart0));

// Function to execute by the comm thread.
void comm_handler(void *_u1, void *_u2, void *_u3);

// Define the sensor thread and immediately start it.
K_THREAD_DEFINE(
    comm_thread,
    CONFIG_COMM_THREAD_STACK_SIZE,
    comm_handler, NULL, NULL, NULL,
    CONFIG_COMM_THREAD_PRIO, 0, 0);

// UART communication handler.
void comm_handler(void *_u1, void *_u2, void *_u3)
{
    ARG_UNUSED(_u1);
    ARG_UNUSED(_u2);
    ARG_UNUSED(_u3);
}
```
