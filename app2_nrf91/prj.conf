## CMakeLists.txt
```
# This file is used by the build system to find sources you want to compile.

# Some basic setup stuff. We won't go into great detail.
cmake_minimum_required(VERSION 3.20.0)
find_package(Zephyr REQUIRED HINTS $ENV{ZEPHYR_BASE})
project(NONE)

target_sources(app PRIVATE
    src/main.c
    src/comm.c
    src/env_sensor.c
    src/io.c
)

# Enable more warnings
target_compile_options(app PRIVATE -Wall -Wextra)
```

## Kconfig
```
# Kconfig files are for defining custom configuration options.
# A config option MY_FOO is available in code as a preprocessor define called CONFIG_MY_FOO.

menu "Zephyr Kernel"
source "Kconfig.zephyr"
endmenu

config SENSOR_UPDATE_INTERVAL_MS
    int "Sensor update interval in milliseconds"
    range 500 86400000
    default 2000

config SENSOR_THREAD_STACK_SIZE
    int "Size of the sensor thread stack"
    default 2048

config SENSOR_THREAD_PRIO
    int "Priority of the sensor thread."
    default 10

config COMM_THREAD_STACK_SIZE
    int "Size of the comm thread stack"
    default 2048

config COMM_THREAD_PRIO
    int "Priority of the comm thread."
    default 10

config COMM_MSGQ_SIZE
    int "Size of the comm module message queue."
    default 4

config TEMPERATURE_MAX_GOOD
    int "Maximum temperature (in degrees celsius) which is considered good."
    default 20

config TEMPERATURE_MAX_OKAY
    int "Maximum temperature (in degrees celsius) which is considered okay."
    default 25
```

## prj.conf
```kconfig
# This file enables submodules and configures all kinds of settings.

# Enable logging via the RTT subsystem
CONFIG_LOG=y
# Set this to y to get immediate logging instead of deferred logging. Might be useful for debugging.
CONFIG_LOG_MODE_IMMEDIATE=n
CONFIG_LOG_BACKEND_RTT=y
CONFIG_USE_SEGGER_RTT=y

# Enable the environmental sensor.
CONFIG_I2C=y
CONFIG_SENSOR=y
# Now, we set the sensor update interval 4 seconds.
CONFIG_SENSOR_UPDATE_INTERVAL_MS=4000

# Enable Zephyr message bus (zbus)
CONFIG_ZBUS=y
```

## thingy91_nrf9160.overlay
```dts
// In an overlay file you can define alternate configurations for your applications.
// You can, for example, enable or disable specific peripherals or remap them to different pins.
```

## src/main.c
```c
// This file conains our application's entry point.

#include <zephyr/kernel.h>
#include <zephyr/logging/log.h>

// We register a log module here so we can use LOG_INF, LOG_ERR, etc. in this
// module.
LOG_MODULE_REGISTER(app);

int main(void)
{
    LOG_INF("entering main");
    // Seems we've got nothing to do here for now...
    return 0;
}
```

## src/channels.h
```c
// This header contains channel and structure definitions used by all the modules accessing zbus.

#ifndef _CHANNEL_H_
#define _CHANNEL_H_

#include <zephyr/kernel.h>
#include <zephyr/zbus/zbus.h>
#include <zephyr/drivers/sensor.h>

// Message containing new measurement values.
// Should be distributed via sensor_channel.
struct sensor_msmt_message {
    int64_t uptime_ms; // System in milliseconds.
    struct sensor_value temperature; // Ambient temperature.
    struct sensor_value pressure; // Ambient pressure.
    struct sensor_value humidity; // Ambient humidity.
    struct sensor_value gas_res; // Gas sensor resistance.
};

// Declares a global sensor channel.
// This does not define the channel! Definition needs to happen in one of the modules.
ZBUS_CHAN_DECLARE(sensor_channel);


// Defines all possible IO request.
enum io_request {
    IO_REQUEST_TRIGGER_MSMT, // Forces new measurement to be taken.
};

// Request message sent by IO modules.
struct io_request_msg {
    enum io_request request; // Request kind.
};

// Channel for sending IO requests.
ZBUS_CHAN_DECLARE(io_channel);

#endif
```

## src/comm.c
```c
// This file implements the communication interface to the NRF52.

#include <zephyr/kernel.h>
#include <zephyr/device.h>
#include <zephyr/drivers/uart.h>
#include <zephyr/logging/log.h>

#include "channels.h"

LOG_MODULE_REGISTER(comm);

// Handle to the UART device.
const struct device *uart = DEVICE_DT_GET(DT_NODELABEL(uart0));

// Message queue for passing measurements to the comm thread.
K_MSGQ_DEFINE(comm_msgq, sizeof(struct sensor_msmt_message), CONFIG_COMM_MSGQ_SIZE, 4);

// Subscriber for sensor values.
static void on_new_measurement(const struct zbus_channel *chan);
ZBUS_LISTENER_DEFINE(comm_measurement_listener, on_new_measurement);
ZBUS_CHAN_ADD_OBS(sensor_channel, comm_measurement_listener, 1);

// Function to execute by the comm thread.
void comm_handler(void *_u1, void *_u2, void *_u3);

// Define the sensor thread and immediately start it.
K_THREAD_DEFINE(
    comm_thread,
    CONFIG_COMM_THREAD_STACK_SIZE,
    comm_handler, NULL, NULL, NULL,
    CONFIG_COMM_THREAD_PRIO, 0, 0);

// UART communication handler.
void comm_handler(void *_u1, void *_u2, void *_u3)
{
    ARG_UNUSED(_u1);
    ARG_UNUSED(_u2);
    ARG_UNUSED(_u3);

    if (!device_is_ready(uart)) {
        LOG_ERR("uart device is not ready");
        return;
    }

    while (true) {
        struct sensor_msmt_message current_message = {0};
        int err = k_msgq_get(&comm_msgq, &current_message, K_FOREVER);
        if (err != 0) {
            LOG_ERR("failed to read data from message queue: %d", err);
            continue;
        }

        // Now, send the frame over UART.
        // Since we are connected to another ARM Cortex-M controller we can just send the structure
        // as it is - without any special serialization.
        for (size_t i = 0; i < sizeof(current_message); i++) {
            // Simply write out all bytes in sequence.
            // Note: A more efficient way would be to use the asynchronous API using DMA transfers.
            uart_poll_out(uart, ((uint8_t *)&current_message)[i]);
        }

        LOG_INF("written message with timestamp %llu to serial line", current_message.uptime_ms);
    }
}

// Passes measurement structure to message queue.
static void on_new_measurement(const struct zbus_channel *chan)
{
    const struct sensor_msmt_message *msg = zbus_chan_const_msg(chan);

    int err = k_msgq_put(&comm_msgq, msg, K_NO_WAIT);
    if (err != 0) {
        LOG_ERR("failed to put message to message queue: %d", err);
    }
}
```

## src/env_sensor.c
```c
// This file includes the sensor handler.

#include <zephyr/kernel.h>
#include <zephyr/device.h>
#include <zephyr/drivers/sensor.h>
#include <zephyr/logging/log.h>

#include "channels.h"

LOG_MODULE_REGISTER(env_sensor);

// Define the zbus channel
ZBUS_CHAN_DEFINE(
    sensor_channel, struct sensor_msmt_message,
    NULL, NULL, ZBUS_OBSERVERS_EMPTY, ZBUS_MSG_INIT(0));

// Handle to the sensor device.
const struct device *sensor = DEVICE_DT_GET_ONE(bosch_bme680);

// Function to execute by the sensor thread.
static void sensor_handler(void *_u1, void *_u2, void *_u3);

// Binary semaphore to trigger measurements.
K_SEM_DEFINE(trigger_measurement, 0, 1);

// Timer which triggers the semaphore periodically to trigger new measurements.
static void on_measurement_due(struct k_timer *timer);
K_TIMER_DEFINE(measurement_trigger, on_measurement_due, NULL);

// Listener for the button press.
static void on_button_trigger(const struct zbus_channel *chan);
ZBUS_LISTENER_DEFINE(button_trigger_listener, on_button_trigger);
ZBUS_CHAN_ADD_OBS(io_channel, button_trigger_listener, 1);

// Define the sensor thread and immediately start it.
K_THREAD_DEFINE(
    env_sens_thread,
    CONFIG_SENSOR_THREAD_STACK_SIZE,
    sensor_handler, NULL, NULL, NULL,
    CONFIG_SENSOR_THREAD_PRIO, 0, 0);

// Sensor handler takes periodic measurements.
void sensor_handler(void *_u1, void *_u2, void *_u3)
{
    ARG_UNUSED(_u1);
    ARG_UNUSED(_u2);
    ARG_UNUSED(_u3);

    if (!device_is_ready(sensor)) {
        LOG_ERR("sensor not ready - aborting");
        return;
    }

    // Schedule the timer.
    k_timer_start(&measurement_trigger, K_NO_WAIT, K_MSEC(CONFIG_SENSOR_UPDATE_INTERVAL_MS));

    while (true) {
        // Wait until we need to sample a new measurement.
        k_sem_take(&trigger_measurement, K_FOREVER);

        // Sensor values of each channel.
        struct sensor_msmt_message meas_msg = {0};
        meas_msg.uptime_ms = k_uptime_get();
    
        int err = sensor_sample_fetch(sensor);
        if (err != 0) {
            LOG_ERR("failed to read sensor value: %d", err);
            continue;
        }
        
        // These calls work once the sample has been fetched.
        (void)sensor_channel_get(sensor, SENSOR_CHAN_AMBIENT_TEMP, &meas_msg.temperature);
        (void)sensor_channel_get(sensor, SENSOR_CHAN_PRESS, &meas_msg.pressure);
        (void)sensor_channel_get(sensor, SENSOR_CHAN_HUMIDITY, &meas_msg.humidity);
        (void)sensor_channel_get(sensor, SENSOR_CHAN_GAS_RES, &meas_msg.gas_res);

        LOG_INF("fetched new sensor sample @ %llums", meas_msg.uptime_ms);

        // Publish the measurement to a channel.
        err = zbus_chan_pub(&sensor_channel, &meas_msg, K_NO_WAIT);
        if (err != 0) {
            LOG_ERR("failed to publish measurement to channel: %d", err);
        }
    }
}

// This function simply triggers the measurement.
static void on_measurement_due(struct k_timer *timer)
{
    ARG_UNUSED(timer);

    k_sem_give(&trigger_measurement);
}

static void on_button_trigger(const struct zbus_channel *chan)
{
    const struct io_request_msg *msg = zbus_chan_const_msg(chan);

    switch (msg->request) {
        case IO_REQUEST_TRIGGER_MSMT:
            // We simply start the timer again and trigger it immediately.
            k_timer_start(
                &measurement_trigger, K_NO_WAIT, K_MSEC(CONFIG_SENSOR_UPDATE_INTERVAL_MS));
            break;
        default:
            break;
    }
}
```

## src/io.c
```c
// This module implements status indicators (LEDs) and buttons for the measurements.

#include <zephyr/kernel.h>
#include <zephyr/device.h>
#include <zephyr/drivers/gpio.h>
#include <zephyr/init.h>
#include <zephyr/logging/log.h>

#include "channels.h"

LOG_MODULE_REGISTER(io);

// Debounce interval of the button in milliseconds.
#define BUTTON_DEBOUNCE_INTERVAL_MS 200

// Work item for handling button presses.
struct button_pressed_worker {
    struct k_work work; // Work item to be executed.
    enum io_request request; // Carries the request to be sent.
};

// Worker for controlling the LEDs.
struct led_control_worker {
    struct k_work work; // Work item to be executed.
    struct sensor_msmt_message sensor_message; // Message containing the sensor value.
};

// Define the IO channel.
ZBUS_CHAN_DEFINE(
    io_channel,
    struct io_request_msg,
    NULL, NULL,
    ZBUS_OBSERVERS_EMPTY, ZBUS_MSG_INIT(0));

// This reads the GPIO settings of the LEDs at compile time.
static const struct gpio_dt_spec red_led_spec = GPIO_DT_SPEC_GET(DT_ALIAS(led0), gpios);
static const struct gpio_dt_spec green_led_spec = GPIO_DT_SPEC_GET(DT_ALIAS(led1), gpios);

// Those are settings for the button.
static const struct gpio_dt_spec button_spec = GPIO_DT_SPEC_GET(DT_ALIAS(sw0), gpios);
static struct gpio_callback button_callback;

// Handler for the button press.
static void on_button_pressed(const struct device *dev, struct gpio_callback *cb, uint32_t pins);
static void reactivate_button(struct k_timer *timer);
static void button_pressed_handler(struct k_work *work);
static struct button_pressed_worker button_worker = {0};
K_SEM_DEFINE(button_press_possible, 1, 1); // Protects the work item from being issued twice.
K_TIMER_DEFINE(button_reactivate_timer, reactivate_button, NULL);

// Listener listening for new sensor values.
static void on_measurement_received(const struct zbus_channel *chan);
ZBUS_LISTENER_DEFINE(io_measurement_listener, on_measurement_received);
ZBUS_CHAN_ADD_OBS(sensor_channel, io_measurement_listener, 1);

// Worker for controlling the LEDs.
static void led_control_handler(struct k_work *work);
static struct led_control_worker led_control_worker;
K_SEM_DEFINE(led_control_ready, 1, 1); // Protects the work item from being issued twice.

// Configuration function for LEDs.
static int configure_led(const struct gpio_dt_spec *spec)
{
    // First, we check whether the GPIO device is ready.
    if (!gpio_is_ready_dt(spec)) {
        LOG_ERR("gpio device not ready");
        return -ECANCELED; // Return code is of no relevance here.
    }

    // Next, we set the pin for the green LED to output low.
    int err = gpio_pin_configure_dt(spec, GPIO_OUTPUT_INACTIVE);
    if (err != 0) {
        LOG_ERR("failed to set gpio mode to output_inactive: %d", err);
        return -ECANCELED;
    }

    return 0;
}

// Cofigures the button.
static int configure_button(const struct gpio_dt_spec *spec, struct gpio_callback *callback)
{
    // First, we check whether the GPIO device is ready.
    if (!gpio_is_ready_dt(spec)) {
        LOG_ERR("gpio device not ready");
        return -ECANCELED; // Return code is of no relevance here.
    }

    // Configure the interrupt.
    int err = gpio_pin_configure_dt(spec, GPIO_INPUT);
    if (err != 0) {
        LOG_ERR("failed to set gpio interrupt mode %d", err);
        return -ECANCELED;
    }

    err = gpio_pin_interrupt_configure_dt(spec, GPIO_INT_EDGE_TO_ACTIVE);
    if (err != 0) {
        LOG_ERR("failed to enable interrupt: %d", err);
        return -ECANCELED;
    }

    gpio_init_callback(callback, on_button_pressed, BIT(spec->pin));
    err = gpio_add_callback(spec->port, callback);
    if (err != 0) {
        LOG_ERR("failed to add gpio callback: %d", err);
        return -ECANCELED;
    }

    return 0;
}

// Delegates the handling of the button press to a work item.
static void on_button_pressed(const struct device *dev, struct gpio_callback *cb, uint32_t pins)
{
    ARG_UNUSED(dev);
    ARG_UNUSED(cb);
    ARG_UNUSED(pins);

    // Disable the interrupt to debounce the timer.
    int err = gpio_pin_interrupt_configure_dt(&button_spec, GPIO_INT_DISABLE);
    if (err != 0) {
        LOG_ERR("failed to enable interrupt: %d", err);
        return;
    }
    k_timer_start(&button_reactivate_timer, K_MSEC(BUTTON_DEBOUNCE_INTERVAL_MS), K_NO_WAIT);
    
    if (k_sem_take(&button_press_possible, K_NO_WAIT) != 0) {
        LOG_WRN("ignoring button press");
        return;
    }

    LOG_INF("new measurement explicitly requested");
    button_worker.request = IO_REQUEST_TRIGGER_MSMT;
    k_work_submit(&button_worker.work);
}

static void reactivate_button(struct k_timer *timer)
{
    ARG_UNUSED(timer);

    int err = gpio_pin_interrupt_configure_dt(&button_spec, GPIO_INT_EDGE_TO_ACTIVE);
    if (err != 0) {
        LOG_ERR("failed to enable interrupt: %d", err);
    }    
}

// Sends a notification about the button press event.
static void button_pressed_handler(struct k_work *work)
{
    struct button_pressed_worker *worker = CONTAINER_OF(work, struct button_pressed_worker, work);
    struct io_request_msg message = {.request = worker->request};

    int err = zbus_chan_pub(&io_channel, &message, K_NO_WAIT);
    if (err != 0) {
        LOG_ERR("failed to publish measurement trigger request: %d", err);
    }

    k_sem_give(&button_press_possible);
}

// Delegates the measurement value to the work queue.
static void on_measurement_received(const struct zbus_channel *chan)
{
    if (k_sem_take(&led_control_ready, K_NO_WAIT) != 0) {
        LOG_WRN("ignoring measurement value");
        return;
    }

    const struct sensor_msmt_message *message = zbus_chan_const_msg(chan);
    led_control_worker.sensor_message = *message;
    k_work_submit(&led_control_worker.work);
}

// Handles the LEDs.
static void led_control_handler(struct k_work *work)
{
    struct led_control_worker *worker = CONTAINER_OF(work, struct led_control_worker, work);
    struct sensor_msmt_message *sens = &worker->sensor_message;

    if (sens->temperature.val1 < CONFIG_TEMPERATURE_MAX_GOOD) {
        (void)gpio_pin_set_dt(&red_led_spec, 0);
        (void)gpio_pin_set_dt(&green_led_spec, 1);
        LOG_INF("temperature is good");
    } else if (sens->temperature.val1 < CONFIG_TEMPERATURE_MAX_OKAY) {
        (void)gpio_pin_set_dt(&red_led_spec, 1);
        (void)gpio_pin_set_dt(&green_led_spec, 1);
        LOG_INF("temperature is warm");
    } else {
        (void)gpio_pin_set_dt(&red_led_spec, 1);
        (void)gpio_pin_set_dt(&green_led_spec, 0);
        LOG_INF("temperature is hot");
    }

    LOG_INF("received measurement from %llums:\n\ttemperature = %d.%d\n\thumidity = %d.%d\n\t"
        "pressure = %d.%d\n\tgas_res = %d.%d",
        sens->uptime_ms, sens->temperature.val1, sens->temperature.val2,
        sens->humidity.val1, sens->humidity.val2, sens->pressure.val1, sens->pressure.val2,
        sens->gas_res.val1, sens->gas_res.val2);

    k_sem_give(&led_control_ready);
}

// Initializer function called before main starts.
// These functions can be used to set up module specific things.
static int init_io(void)
{
    // Configure LEDs and button here.
    int err = 0;

    err = configure_led(&red_led_spec);
    if (err != 0) {
        LOG_ERR("failed to configure red led: %d", err);
        return err;
    }

    err = configure_led(&green_led_spec);
    if (err != 0) {
        LOG_ERR("failed to configure green led: %d", err);
        return err;
    }


    err = configure_button(&button_spec, &button_callback);
    if (err != 0) {
        LOG_ERR("failed to configure button: %d", err);
        return err;
    }

    k_work_init(&button_worker.work, button_pressed_handler);
    k_work_init(&led_control_worker.work, led_control_handler);

    // If ok, return 0.
    return err;
}

// The APPLICATION init level is the init level before main.
SYS_INIT(init_io, APPLICATION, 0);
```
